## arch/arm/mach-stm32/stm32f4/Kconfig
```kconfig
if STM32F4

config TARGET_STM32F407_PRO
	bool "STM32F407 Pro board"

config TARGET_STM32F429_DISCOVERY
	bool "STM32F429 Discovery board"

config TARGET_STM32F429_EVALUATION
	bool "STM32F429 Evaluation board"

config TARGET_STM32F469_DISCOVERY
	bool "STM32F469 Discovery board"

source "board/st/stm32f407-pro/Kconfig"
source "board/st/stm32f429-discovery/Kconfig"
source "board/st/stm32f429-evaluation/Kconfig"
source "board/st/stm32f469-discovery/Kconfig"

endif
```

## board/st/stm32f407-pro/Kconfig
```kconfig
if TARGET_STM32F407_PRO

config SYS_BOARD
	default "stm32f407-pro"

config SYS_VENDOR
	default "st"

config SYS_SOC
	default "stm32f4"

config SYS_CONFIG_NAME
	default "stm32f407-pro"

endif
```
